## conf/distro/installer.conf
```bitbake
# use systemd as the default init manager
# comment the following lines to use 'sysvinit' as the init manager
VIRTUAL-RUNTIME_init_manager = "systemd"
DISTRO_FEATURES_BACKFILL_CONSIDERED_append = " sysvinit"
DISTRO_FEATURES_append = " systemd"

DISTRO_FEATURES_append = " \
    x11 \
    opengl \
"

VIRTUAL-RUNTIME_base-utils = "busybox"

SYSTEMD_AUTO_ENABLE_pn-lvm2 = "enable"

KERNEL_CLASSES_append = " installer_kernel"

IMAGE_FEATURES_append = " package-management"

# xserver-nodm-init, anaconda-init
VIRTUAL-RUNTIME_graphical_init_manager = "anaconda-init"

IMAGE_FSTYPES_remove = "wic wic.bmap"
IMAGE_FSTYPES_pn-core-image-installer_append = " live"
NOHDD_pn-core-image-installer = "1"

# Want ldconfig in the output package
# The python module require it
DISTRO_FEATURES_append = " ldconfig"

# It works for both of syslinux and grub-efi
LABELS_LIVE = "boot"

QB_MEM_qemux86-64 = "-m 2048"


HOSTTOOLS_append = " tac"

MACHINE_FEATURES_append = " efi pcbios"

UVESA_MODE = "1024x768-32"

IMAGE_ROOTFS_EXTRA_SPACE_append_pn-wrlinux-image-installer =" + 102400"
```

## conf/distro/wrlinux-installer-whitelist.inc
```bitbake
# Whitelist for meta-openembedded/meta-gnome
PNWHITELIST_gnome-layer += "\
    gnome-themes \
    gtk-engines \
    libgnomecanvas \
    libgnome-keyring \
    libxklavier \
    network-manager-applet \
"

# Whitelist for meta-openembedded/meta-python
PNWHITELIST_meta-python += "\
    python3-blivet \
    python3-blivetgui \
    python3-chardet \
    python3-certifi \
    python3-cffi \
    python3-coverage \
    python3-cryptography \
    python3-dbus \
    python3-idna \
    python3-langtable \
    python3-ndg-httpsclient \
    python3-ntplib \
    python3-ordered-set \
    python3-py \
    python3-pyasn1 \
    python3-pycparser \
    python3-pykickstart \
    python3-pyopenssl \
    python3-pyparted \
    python3-pysocks \
    python3-pytest-runner \
    python3-pytz \
    python3-pyudev \
    python3-requests \
    python3-setuptools-scm \
    python3-urllib3 \
"

# Whitelist for meta-openembedded/meta-filesystems
PNWHITELIST_filesystems-layer += "\
    ntfs-3g-ntfsprogs \
"

# Whitelist for meta-openembedded/meta-oe
PNWHITELIST_openembedded-layer += "\
    libblockdev \
    fltk \
    fontforge \
    giflib \
    glade \
    libndp \
    libvncserver \
    mozjs \
    networkmanager \
    polkit \
    ttf-abyssinica \
    ttf-dejavu \
    ttf-lklug \
    ttf-lohit \
    ttf-sazanami \
    ttf-wqy-zenhei \
    ttf-tlwg \
    uthash \
    x11vnc \
"
```

## conf/distro/wrlinux-installer.conf
```bitbake
#@TYPE: Distro
#@NAME: Wind River Linux Installer
#@DESCRIPTION: Wind River Linux (Anaconda-based Target Installer)

require conf/distro/wrlinux.conf
require conf/distro/installer.conf
include wrlinux-installer-whitelist.inc

DISTRO_FEATURES_BACKFILL_CONSIDERED += "installer-support"

IMAGE_FSTYPES_pn-wrlinux-image-installer_append = " live"

OVERRIDES_append = ":installer"

CUSTOMIZE_LOGOS ?= "windriver-logos"
```

## conf/layer.conf
```bitbake
# We have a conf and classes directory, add to BBPATH
BBPATH =. "${LAYERDIR}:"

LAYER_PATH_wr-installer = "${LAYERDIR}"

# We have a packages directory, add to BBFILES
BBFILES += "${LAYERDIR}/recipes-*/*/*.bb \
            ${LAYERDIR}/recipes-*/*/*.bbappend \
            ${LAYERDIR}/meta-openembedded/meta-*/recipes-*/*/*.bb \
            ${LAYERDIR}/meta-openembedded/meta-*/recipes-*/*/*.bbappend"

BBFILE_COLLECTIONS += "wr-installer"
BBFILE_PATTERN_wr-installer = "^${LAYERDIR}/"
BBFILE_PRIORITY_wr-installer = "10"

# By default disable all of the components of this layer
# unless the wrlinux-installer distribution is enabled.
LAYERNAME = "wr-installer"
LAYERNAME_wrlinux-installer = ""
PNWHITELIST_LAYERS_append = " ${LAYERNAME}"
PNWHITELIST_REASON_wr-installer = "Installer components are only enabled \
when using the wrlinux-installer distro."

LAYERVERSION_wr-installer = "2"

LAYERDEPENDS_wr-installer = "core wr-userspace-base filesystems-layer gnome-layer"

LAYERRECOMMENDS_wr-installer = "wr-installer-dl"

LICENSE_PATH += "${LAYERDIR}/licenses"
SRC_DISTRIBUTE_LICENSES += "X11"
SRC_DISTRIBUTE_LICENSES += "FLTK"
```
